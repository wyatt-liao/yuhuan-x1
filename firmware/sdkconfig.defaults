## firmware/sdkconfig.defaults
```kconfig
CONFIG_IDF_TARGET="esp32s3"
CONFIG_ESPTOOLPY_FLASHSIZE_16MB=y
CONFIG_PARTITION_TABLE_CUSTOM=y
CONFIG_PARTITION_TABLE_CUSTOM_FILENAME="partitions.csv"
CONFIG_SPIRAM=y
CONFIG_SPIRAM_MODE_OCT=y
CONFIG_SPIRAM_SPEED_80M=y
CONFIG_SPIRAM_USE_MALLOC=y
CONFIG_FREERTOS_HZ=1000
CONFIG_PM_ENABLE=y
CONFIG_ESP_DEFAULT_CPU_FREQ_MHZ_160=y
CONFIG_ESP_CONSOLE_USB_SERIAL_JTAG=y
CONFIG_BT_ENABLED=y
CONFIG_BT_NIMBLE_ENABLED=y
CONFIG_BT_NIMBLE_MAX_CONNECTIONS=1
CONFIG_BT_NIMBLE_ATT_PREFERRED_MTU=247
CONFIG_BT_NIMBLE_NVS_PERSIST=y
CONFIG_BT_NIMBLE_ROLE_CENTRAL=n
CONFIG_BT_NIMBLE_ROLE_OBSERVER=n
CONFIG_FATFS_LFN_HEAP=y
CONFIG_FATFS_MAX_LFN=128
CONFIG_FATFS_FS_LOCK=8
CONFIG_FATFS_PER_FILE_CACHE=y
CONFIG_COMPILER_CXX_EXCEPTIONS=n
CONFIG_COMPILER_CXX_RTTI=n
CONFIG_ESP_MAIN_TASK_STACK_SIZE=8192
```

## outputs/yuhuan-x1-firmware/main/Kconfig.projbuild
```kconfig
menu "Yuhuan X1"
config YH_BUTTON2_GPIO
    int "Second function button GPIO (-1 disables)"
    range -1 48
    default 15
    help
        Revised PCB: SW2 is isolated from EN and connects to GPIO15.
        Original PCB requires -1. Verify PCB revision before flashing.
config YH_SD_SPI_MHZ
    int "SD SPI clock MHz (start conservatively for first board)"
    range 4 20
    default 10
config YH_LOW_BATTERY_MV
    int "Low-battery shutdown threshold at battery connector, mV"
    range 3000 3600
    default 3300
config YH_WIFI_IDLE_SECONDS
    int "Turn Wi-Fi off after this many seconds without application traffic"
    range 30 3600
    default 120
endmenu
```
